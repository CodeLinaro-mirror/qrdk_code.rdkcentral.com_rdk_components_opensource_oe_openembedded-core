## meta/conf/distro/include/lto.inc
```bitbake
LTO_pn-glibc = ""
LTO_pn-glibc-initial = ""
LTO_pn-eglibc = ""
LTO_pn-eglibc-initial = ""
LTO_pn-gcc-runtime = ""
LTO_pn-libgcc-initial = ""
LTO_pn-libgcc = ""
LTO_pn-libpam = ""
LTO_pn-elfutils = ""
LTO_pn-perl = ""
LTO_pn-busybox = ""
LTO_pn-libxcrypt = ""
LTO_pn-curl = ""
LTO_pn-libcap = ""
LTO_pn-python3 = ""
LTO_pn-libproxy = ""
LTO_pn-libbsd = ""
LTO_pn-gettext = ""
LTO_pn-socat = ""
LTO_pn-kmod = ""
LTO_pn-libcheck = ""
LTO_pn-pixman = ""
LTO_pn-m4 = ""
LTO_pn-attr = ""
LTO_pn-flac = ""
LTO_pn-libevdev = ""
LTO_pn-libidn = ""
LTO_pn-mpg123 = ""
LTO_pn-bash = ""
LTO_pn-coreutils = ""
LTO_pn-kbd = ""
LTO_pn-dropbear = ""
LTO_pn-shadow = ""
LTO_pn-util-linux = ""
LTO_pn-gobject-introspection = ""
LTO_pn-vala = ""
LTO_pn-acl = ""
LTO_pn-gdk-pixbuf = ""
LTO_pn-bind = ""
LTO_pn-e2fsprogs = ""
LTO_pn-gnutls = ""
LTO_pn-mtd-utils = ""
LTO_pn-pciutils = ""
LTO_pn-usbutils = ""
LTO_pn-glib-networking = ""
LTO_pn-dbus = ""
LTO_pn-neon = ""
LTO_pn-cairo = ""
LTO_pn-alsa-lib = ""
LTO_pn-sbc = ""
LTO_pn-readline = ""
LTO_pn-ncurses = ""
LTO_pn-libarchive = ""
LTO_pn-wireless-tools = ""
LTO_pn-python3-pygobject = ""
LTO_pn-dbus-glib = ""
LTO_pn-nettle = ""
LTO_pn-icu = ""
LTO_pn-libpcap = ""
LTO_pn-iptables = ""
LTO_pn-python = ""
LTO_pn-tcp-wrappers = ""

LTO ?= "${@bb.utils.contains('DISTRO_FEATURES', 'lto', '-flto', '', d)}"

SELECTED_OPTIMIZATION_append_class-target = " ${LTO}"
TARGET_LDFLAGS_append_class-target = " ${LTO}"

SELECTED_OPTIMIZATION[vardeps] += "LTO"

PACKAGE_DEBUG_SPLIT_STYLE = "debug-without-src"
```
